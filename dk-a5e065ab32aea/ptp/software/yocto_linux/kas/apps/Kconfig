## dk-a5e065ab32aea/ptp/software/yocto_linux/kas/apps/Kconfig
```kconfig
menu "Example applications"

config PACKET_GENERATOR_APP
	bool "Packet Generator"
    default y

config PACKET_SWITCH_APP
	bool "Packet Switch Application"
    default y

endmenu
```

## dk-a5e065ab32aea/ptp/software/yocto_linux/kas/gsrd/Kconfig
```kconfig
if GSRD_CONSOLE_IMAGE_BUILD
menu "Networking libraries and applications"

config APP_LINUXPTP
    bool "linuxptp"
    default y
    help
      linuxptp - Linux precision time protocol implementation for clock
      synchronization over networks.

config LIB_OPEN62541
    bool "open62541 library"
    default y
    help
      open62541 - OPC UA library for embedded systems.

config NET_APP_LINUXPTP
    string
    default "true" if APP_LINUXPTP
    default "false" if !APP_LINUXPTP

config NET_LIB_OPEN62541
    string
    default "true" if LIB_OPEN62541
    default "false" if !LIB_OPEN62541

endmenu
endif

if GSRD_CONSOLE_IMAGE_BUILD
menu "Benchmarking applications"

config APP_COREMARK
    bool "CoreMark"
    default y
    help
      CoreMark - EEMBC benchmark for evaluating embedded CPU performance through lightweight core tests.

config BENCHMARK_APP_COREMARK
    string
    default "true" if APP_COREMARK
    default "false" if !APP_COREMARK

config APP_DHRYSTONE
    bool "Dhrystone"
    default y
    help
      Dhrystone - benchmark for CPU/compiler performance measurement, in particular in the area of minicomputers, workstations, PCs, and microprocesors.

config BENCHMARK_APP_DHRYSTONE
    string
    default "true" if APP_DHRYSTONE
    default "false" if !APP_DHRYSTONE

config APP_STREAM
    bool "STREAM"
    default y
    help
      STREAM - de facto industry standard benchmark for measuring sustained memory bandwidth.

config BENCHMARK_APP_STREAM
    string
    default "true" if APP_STREAM
    default "false" if !APP_STREAM

config APP_LMBENCH
    bool "LMbench"
    default y
    help
      LMbench - a suite of simple, portable, ANSI/C microbenchmarks for UNIX/POSIX.

config BENCHMARK_APP_LMBENCH
    string
    default "true" if APP_LMBENCH
    default "false" if !APP_LMBENCH

config APP_RUN_HPS_BENCHMARKS
    bool "Sample Benchmarking Script"
    default y
    help
      CoreMark - Example script for running benchmarking commands

config BENCHMARK_APP_RUN_HPS_BENCHMARKS
    string
    default "true" if APP_RUN_HPS_BENCHMARKS
    default "false" if !APP_RUN_HPS_BENCHMARKS

config UTIL_NUMACTL
    bool "numactl"
    default n
    help
      numactl - Utility to control NUMA memory and CPU affinity policies for
      performance optimization on NUMA architectures.

config TOOLS_UTIL_NUMACTL
    string
    default "true" if UTIL_NUMACTL
    default "false" if !UTIL_NUMACTL

endmenu
endif

menu "Altera Linux applications"

config CONFIG_PACKET_GENERATOR
    string
    default y

config CONFIG_PACKET_SWITCH
    string
    default y

config CONFIG_SETUP_TOOLS
    string
    default y
endmenu
```
